## configs/avaota_f2_defconfig
```kconfig
CONFIG_RISCV=y
CONFIG_SYS_MALLOC_LEN=0x800000
CONFIG_SYS_MALLOC_F_LEN=0x4000
CONFIG_NR_DRAM_BANKS=1
CONFIG_HAS_CUSTOM_SYS_INIT_SP_ADDR=y
CONFIG_CUSTOM_SYS_INIT_SP_ADDR=0x47f00000
CONFIG_DEFAULT_DEVICE_TREE="sun252i-v861-avaota-f2"
CONFIG_SYS_LOAD_ADDR=0x43000000
CONFIG_SPL_TEXT_BASE=0x00100060
CONFIG_SPL_BSS_START_ADDR=0x0011d000
CONFIG_SPL_BSS_MAX_SIZE=0x1000
CONFIG_SPL_STACK=0x00120000
CONFIG_SPL_HAVE_INIT_STACK=y
# CONFIG_SPL_SHARES_INIT_SP_ADDR is not set
CONFIG_SPL_SIZE_LIMIT=0x1cb80
CONFIG_SPL_MAX_SIZE=0x1cfa0
CONFIG_SPL=y
CONFIG_SPL_SYS_MALLOC=y
CONFIG_SPL_HAS_CUSTOM_MALLOC_START=y
CONFIG_SPL_CUSTOM_SYS_MALLOC_ADDR=0x44000000
CONFIG_SPL_SYS_MALLOC_SIZE=0x100000
CONFIG_SPL_SYS_DCACHE_OFF=y
CONFIG_TARGET_SUN252I=y
CONFIG_RISCV_TIMER=y
CONFIG_ARCH_RV32I=y
CONFIG_RISCV_ISA_ZICBOM=y
CONFIG_SPL_RISCV_ISA_ZICBOM=y
CONFIG_SPL_BOARD_INIT=y
CONFIG_SPL_GPIO=y
CONFIG_RISCV_SMODE=y
CONFIG_SPL_RISCV_MMODE=y
# CONFIG_SPL_SMP is not set
CONFIG_FIT=y
# CONFIG_SPL_FIT_IMAGE_TINY is not set
CONFIG_BOOTSTD_FULL=y
CONFIG_BOOTSTD_DEFAULTS=y
CONFIG_USE_BOOTCOMMAND=y
CONFIG_SPL_SPI=y
CONFIG_SPL_DM_SPI=y
CONFIG_SPL_SPI_FLASH_SUPPORT=y
CONFIG_SPL_DM_SPI_FLASH=y
CONFIG_SPL_SPI_LOAD=y
# CONFIG_SPL_SPI_FLASH_TINY is not set
CONFIG_SPL_SPI_FLASH_SFDP_SUPPORT=y
CONFIG_SPL_LOAD_FIT=y
CONFIG_SPL_OPENSBI=y
CONFIG_SPL_OPENSBI_SCRATCH_OPTIONS=0x0
CONFIG_SPL_OPENSBI_LOAD_ADDR=0x40f80000
CONFIG_SPL_HAS_LOAD_FIT_ADDRESS=y
CONFIG_SPL_LOAD_FIT_ADDRESS=0x43400000
CONFIG_SYS_SPI_U_BOOT_OFFS=0x20000
CONFIG_HUSH_PARSER=y
# CONFIG_MISC_INIT_R is not set
CONFIG_ENV_IS_NOWHERE=y
# CONFIG_ENV_IS_IN_FAT is not set
# CONFIG_ENV_IS_IN_SPI_FLASH is not set
# CONFIG_PHY_SUN4I_USB is not set
CONFIG_CMD_UFETCH=y
CONFIG_I2C=y
CONFIG_DM_I2C=y
CONFIG_SYS_I2C_MVTWSI=y
CONFIG_SPL_I2C=y
CONFIG_SPL_DM_I2C=y
CONFIG_DM_PMIC=y
CONFIG_PMIC_AXP=y
CONFIG_AXP333_POWER=y
CONFIG_AXP_DCDC1_VOLT=940
CONFIG_AXP_DCDC2_VOLT=1500
CONFIG_SPL_POWER=y
CONFIG_SPL_DM_PMIC=y
CONFIG_SPL_PMIC_AXP=y
CONFIG_DM_REGULATOR=y
CONFIG_REGULATOR_AXP=y
CONFIG_CMD_I2C=y
CONFIG_CMD_PMIC=y
CONFIG_CMD_REGULATOR=y
CONFIG_MMC=y
CONFIG_MMC_SUNXI=y
CONFIG_CMD_MMC=y
CONFIG_SPI=y
CONFIG_DM_SPI=y
CONFIG_SPI_SUNXI_SPIF=y
# CONFIG_SPI_SUNXI is not set
CONFIG_DM_SPI_FLASH=y
CONFIG_SPI_FLASH=y
CONFIG_SPI_FLASH_SFDP_SUPPORT=y
# CONFIG_SPI_FLASH_UNLOCK_ALL is not set
CONFIG_SPI_FLASH_GIGADEVICE=y
CONFIG_SPI_FLASH_MACRONIX=y
CONFIG_SPI_FLASH_PUYA=y
CONFIG_SPI_FLASH_WINBOND=y
CONFIG_SPI_FLASH_XMC=y
CONFIG_CMD_SF=y
CONFIG_SF_DEFAULT_SPEED=50000000
CONFIG_SYSRESET=y
CONFIG_SYSRESET_SBI=y
CONFIG_WDT=y
CONFIG_WDT_SUNXI=y
CONFIG_CMD_WDT=y
# CONFIG_WATCHDOG_AUTOSTART is not set
CONFIG_WATCHDOG_TIMEOUT_MSECS=16000
# CONFIG_SPL_MMC is not set
CONFIG_SYS_PROMPT="sun252i# "
# CONFIG_NET is not set
# CONFIG_EFI_LOADER is not set
CONFIG_SYS_NS16550=y
CONFIG_SYS_NS16550_MEM32=y
CONFIG_DRAM_CLK=1056
CONFIG_DRAM_ZQ=8088571
CONFIG_DRAM_SUNXI_ODT_EN=0x1
CONFIG_DRAM_SUNXI_TPR0=0x004a2195
CONFIG_DRAM_SUNXI_TPR11=0x00460000
CONFIG_DRAM_SUNXI_TPR12=0x00000055
CONFIG_DRAM_SUNXI_TPR13=0x34040500
CONFIG_DRAM_SUNXI_MR1=0x2
CONFIG_DRAM_SUNXI_TPR7=0x1621121e
# CONFIG_DEBUG_UART is not set
# CONFIG_TOOLS_MKEFICAPSULE is not set
```

## configs/p100_haps_defconfig
```kconfig
CONFIG_RISCV=y
CONFIG_TEXT_BASE=0x90000000
CONFIG_SYS_MALLOC_LEN=0x4000000
CONFIG_SYS_MALLOC_F_LEN=0x3000
CONFIG_HAS_CUSTOM_SYS_INIT_SP_ADDR=y
CONFIG_CUSTOM_SYS_INIT_SP_ADDR=0x90100000
CONFIG_SF_DEFAULT_MODE=0x3
CONFIG_ENV_SIZE=0x4000
CONFIG_ENV_OFFSET=0x4400
CONFIG_DM_GPIO=y
CONFIG_DEFAULT_DEVICE_TREE="p100-haps"
CONFIG_ENV_OFFSET_REDUND=0x84000
CONFIG_SYS_LOAD_ADDR=0x90000000
CONFIG_TARGET_P100_EVB=y
CONFIG_P100_EVB_ON_HAPS=y
CONFIG_ARCH_RV64I=y
CONFIG_DISTRO_DEFAULTS=y
CONFIG_NAND_BOOT=y
CONFIG_QSPI_BOOT=y
CONFIG_SD_BOOT=y
CONFIG_SPI_BOOT=y
CONFIG_CONSOLE_MUX=y
CONFIG_DISPLAY_CPUINFO=y
CONFIG_DISPLAY_BOARDINFO=y
CONFIG_BOARD_EARLY_INIT_F=y
CONFIG_BOARD_LATE_INIT=y
CONFIG_SYS_PROMPT="u-boot# "
CONFIG_CMD_ERASEENV=y
CONFIG_CMD_MD5SUM=y
CONFIG_CMD_MEMINFO=y
CONFIG_CMD_MEMTEST=y
CONFIG_CMD_GPIO=y
CONFIG_CMD_GPT=y
CONFIG_CMD_I2C=y
CONFIG_CMD_MMC=y
CONFIG_CMD_MTD=y
CONFIG_CMD_SF_TEST=y
CONFIG_CMD_SPI=y
CONFIG_CMD_TFTPPUT=y
CONFIG_CMD_TFTPSRV=y
CONFIG_CMD_EXT4_WRITE=y
# CONFIG_DOS_PARTITION is not set
# CONFIG_ISO_PARTITION is not set
CONFIG_PARTITION_TYPE_GUID=y
CONFIG_OF_EMBED=y
CONFIG_ENV_IS_IN_MMC=y
CONFIG_SYS_REDUNDAND_ENVIRONMENT=y
CONFIG_SYS_RELOC_GD_ENV_ADDR=y
CONFIG_ENV_VARS_UBOOT_RUNTIME_CONFIG=y
CONFIG_NET_RANDOM_ETHADDR=y
CONFIG_TFTP_PORT=y
CONFIG_USB_FUNCTION_FASTBOOT=y
CONFIG_UDP_FUNCTION_FASTBOOT=y
CONFIG_FASTBOOT_BUF_ADDR=0x91000000
CONFIG_FASTBOOT_BUF_SIZE=0x8000000
CONFIG_FASTBOOT_FLASH=y
CONFIG_FASTBOOT_FLASH_MMC_DEV=0
CONFIG_FASTBOOT_MMC_BOOT_SUPPORT=y
CONFIG_FASTBOOT_MMC_USER_SUPPORT=y
CONFIG_FASTBOOT_FLASH_NOR=y
CONFIG_DWAPB_GPIO=y
CONFIG_DM_I2C=y
CONFIG_I2C_SET_DEFAULT_BUS_NUM=y
CONFIG_SYS_I2C_DW=y
CONFIG_MMC=y
CONFIG_MMC_BROKEN_CD=y
CONFIG_MMC_SDHCI=y
# CONFIG_MMC_SDHCI_ADMA_64BIT is not set
CONFIG_MMC_SDHCI_ZHIHE=y
CONFIG_DM_MTD=y
# CONFIG_MTD_RAW_NAND is not set
CONFIG_MTD_SPI_NAND=y
# CONFIG_SPI_FLASH_SMART_HWCAPS is not set
CONFIG_SPI_FLASH_GIGADEVICE=y
CONFIG_SPI_FLASH_ISSI=y
CONFIG_SPI_FLASH_MACRONIX=y
CONFIG_SPI_FLASH_STMICRO=y
CONFIG_SPI_FLASH_WINBOND=y
CONFIG_SPI_FLASH_MTD=y
CONFIG_PHY_MARVELL=y
CONFIG_DWC_ETH_QOS=y
CONFIG_DWC_ETH_QOS_ZHIHE=y
CONFIG_RGMII=y
CONFIG_MII=y
CONFIG_PHY=y
CONFIG_SYS_NS16550=y
CONFIG_SYS_NS16550_MEM32=y
CONFIG_SPI=y
CONFIG_DESIGNWARE_QSPI=y
CONFIG_USB=y
CONFIG_USB_GADGET=y
CONFIG_USB_GADGET_VENDOR_NUM=0x1209
CONFIG_USB_GADGET_PRODUCT_NUM=0xd00d
CONFIG_USB_GADGET_DWC2_OTG=y
CONFIG_USB_GADGET_DWC2_OTG_PHY_BUS_WIDTH_8=y
# CONFIG_EFI_LOADER is not set
```

## configs/p100_spl_sim_K4U6E3S4AA_3733_defconfig
```kconfig
CONFIG_RISCV=y
CONFIG_TEXT_BASE=0x90000000
CONFIG_SYS_MALLOC_LEN=0x4000000
CONFIG_SYS_MALLOC_F_LEN=0x6000
CONFIG_HAS_CUSTOM_SYS_INIT_SP_ADDR=y
CONFIG_CUSTOM_SYS_INIT_SP_ADDR=0x90100000
CONFIG_SF_DEFAULT_MODE=0x3
CONFIG_ENV_SIZE=0x10000
CONFIG_ENV_OFFSET=0x80000
CONFIG_DM_GPIO=y
CONFIG_DEFAULT_DEVICE_TREE="p100-spl-emu"
CONFIG_SPL_TEXT_BASE=0x70000800
CONFIG_SPL_STACK=0x70100000
CONFIG_SPL_BSS_START_ADDR=0x700F0000
CONFIG_SPL_BSS_MAX_SIZE=0x2000
CONFIG_SPL=y
CONFIG_ENV_OFFSET_REDUND=0x100000
CONFIG_SYS_LOAD_ADDR=0x8C000000
CONFIG_BUILD_TARGET="zhihe-rvbl.bin"
# CONFIG_DEBUG_UART is not set
CONFIG_TARGET_P100_EVB=y
CONFIG_P100_EVB_ON_EMU=y
CONFIG_ZHP100EVB_LP4X_512M32_3733_1R_K4U6E3S4AA_2D=y
CONFIG_ARCH_RV64I=y
CONFIG_RISCV_SMODE=y
# CONFIG_SPL_SMP is not set
# CONFIG_OF_BOARD_FIXUP is not set
CONFIG_DISTRO_DEFAULTS=y
CONFIG_NAND_BOOT=y
CONFIG_QSPI_BOOT=y
CONFIG_SD_BOOT=y
CONFIG_SPI_BOOT=y
CONFIG_OF_BOARD_SETUP=y
CONFIG_CONSOLE_MUX=y
CONFIG_DISPLAY_CPUINFO=y
CONFIG_DISPLAY_BOARDINFO=y
CONFIG_BOARD_EARLY_INIT_F=y
CONFIG_BOARD_LATE_INIT=y
CONFIG_SPL_MAX_SIZE=0xEF800
CONFIG_SPL_PAD_TO=0x0
CONFIG_SPL_BOARD_INIT=y
# CONFIG_SPL_RAW_IMAGE_SUPPORT is not set
# CONFIG_SPL_LEGACY_IMAGE_FORMAT is not set
# CONFIG_SPL_SHARES_INIT_SP_ADDR is not set
CONFIG_SPL_SYS_MALLOC=y
CONFIG_SPL_HAS_CUSTOM_MALLOC_START=y
CONFIG_SPL_CUSTOM_SYS_MALLOC_ADDR=0x8E000000
# CONFIG_SPL_BANNER_PRINT is not set
CONFIG_SPL_FS_EXT4=y
CONFIG_SPL_FS_LOAD_PAYLOAD_NAME="riscv-linux.itb"
CONFIG_SYS_PROMPT="u-boot# "
CONFIG_CMD_ERASEENV=y
CONFIG_CMD_MD5SUM=y
CONFIG_CMD_MEMINFO=y
CONFIG_CMD_MEMTEST=y
CONFIG_CMD_GPIO=y
CONFIG_CMD_GPT=y
CONFIG_CMD_I2C=y
CONFIG_CMD_MMC=y
CONFIG_CMD_MTD=y
CONFIG_CMD_SF_TEST=y
CONFIG_CMD_SPI=y
CONFIG_CMD_TFTPPUT=y
CONFIG_CMD_TFTPSRV=y
CONFIG_CMD_EXT4_WRITE=y
# CONFIG_DOS_PARTITION is not set
# CONFIG_ISO_PARTITION is not set
CONFIG_PARTITION_TYPE_GUID=y
CONFIG_OF_SPL_REMOVE_PROPS=""
CONFIG_ENV_IS_IN_MMC=y
CONFIG_SYS_REDUNDAND_ENVIRONMENT=y
CONFIG_SYS_RELOC_GD_ENV_ADDR=y
CONFIG_ENV_VARS_UBOOT_RUNTIME_CONFIG=y
CONFIG_NET_RANDOM_ETHADDR=y
CONFIG_SPL_CLK=y
CONFIG_SPL_CLK_CCF=y
CONFIG_CLK_CCF=y
CONFIG_CLK_ZHIHE_P100=y
CONFIG_DWAPB_GPIO=y
CONFIG_DM_I2C=y
CONFIG_I2C_SET_DEFAULT_BUS_NUM=y
CONFIG_SYS_I2C_DW=y
CONFIG_MMC=y
CONFIG_MMC_BROKEN_CD=y
CONFIG_MMC_SDHCI=y
# CONFIG_MMC_SDHCI_ADMA_64BIT is not set
CONFIG_MMC_SDHCI_ZHIHE=y
CONFIG_DM_MTD=y
# CONFIG_MTD_RAW_NAND is not set
CONFIG_MTD_SPI_NAND=y
# CONFIG_SPI_FLASH_SMART_HWCAPS is not set
CONFIG_SPI_FLASH_GIGADEVICE=y
CONFIG_SPI_FLASH_ISSI=y
CONFIG_SPI_FLASH_MACRONIX=y
CONFIG_SPI_FLASH_STMICRO=y
CONFIG_SPI_FLASH_WINBOND=y
CONFIG_SPI_FLASH_MTD=y
CONFIG_PHY_MARVELL=y
CONFIG_DWC_ETH_QOS=y
CONFIG_DWC_ETH_QOS_ZHIHE=y
CONFIG_RGMII=y
CONFIG_MII=y
CONFIG_PHY=y
CONFIG_SYS_NS16550=y
CONFIG_SYS_NS16550_MEM32=y
CONFIG_SPI=y
CONFIG_DESIGNWARE_QSPI=y
CONFIG_SHA1=y
CONFIG_SHA256=y
# CONFIG_SPL_SHA1 is not set
CONFIG_SPL_GZIP=y
# CONFIG_EFI_LOADER is not set
```

## drivers/clk/zhihe/Kconfig
```kconfig
# SPDX-License-Identifier: GPL-2.0

config CLK_ZHIHE_A210
	bool "Clock driver for ZhiHe A210"
	depends on CLK
	help
	  This clock driver adds support for clock related settings for
	  Zhihe A210 soc.
```
