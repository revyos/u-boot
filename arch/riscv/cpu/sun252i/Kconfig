## board/zhihe/p100-evb/riscv-linux.its
```
/dts-v1/;

/ {
	description = "ZhiHe P100 FIT image";
	#address-cells = <1>;
 
	images {
		kernel-1 {
			description = "Linux Kernel";
			data = /incbin/("replace-path/Image");
			type = "kernel";
			os = "linux";
			arch = "riscv";
			compression = "none";
			load = <0x80200000>;
			entry = <0x80200000>;
			invalid_hash {
				algo = "sha256";
			};
		};
	
		fdt-1 {
			description = "Device Tree";
			data = /incbin/("replace-path/replace-dtb");
			type = "flat_dt";
			arch = "riscv";
			compression = "none";
			load = <0x9ff00000>;
			invalid_hash {
				algo = "sha256";
			};
		};

		opensbi-1 {
			description = "RISC-V OpenSBI";
			data = /incbin/("replace-path/fw_dynamic.bin");
			type = "firmware";
			os = "opensbi";
			arch = "riscv";
			compression = "none";
			load = <0x80000000>;
			entry = <0x80000000>;
			invalid_hash {
				algo = "sha256";
			};
		};

		u-boot-1 {
			description = "U-Boot";
			data = /incbin/("replace-path/u-boot.bin");
			type = "firmware";
			os = "u-boot";
			arch = "riscv";
			compression = "none";
			load = <0x90000000>;
			entry = <0x90000000>;
			invalid_hash {
				algo = "sha256";
			};
		};

		aon-1 {
			description = "AON";
			data = /incbin/("replace-path/firmware/p100_aon.bin");
			type = "firmware";
			arch = "riscv";
			compression = "none";
			load = <0x308f8000>;
			entry = <0x308f8000>;
			invalid_hash {
				algo = "sha256";
			};
		};

		initrd-1 {
			description = "INITRD";
			data = /incbin/("replace-path/initrd");
			type = "firmware";
			arch = "riscv";
			compression = "none";
			load = <0x9e000000>;
			entry = <0x9e000000>;
			invalid_hash {
				algo = "sha256";
			};
		};
	};


	configurations {
		default = "conf-1";
		conf-1 {
			description = "Default Configuration";
			fdt = "fdt-1";
			firmware = "opensbi-1";
			kernel = "kernel-1";
			uboot = "u-boot-1";
			aon = "aon-1";
			initrd = "initrd-1";
			loadables = "u-boot-1", "kernel-1", "aon-1", "initrd-1";
			invalid_signature {
				algo = "sha256,rsa2048";
				key-name-hint = "signature_key_name";
				sign-images = "kernel", "fdt", "firmware", "uboot", "aon", "initrd";
			};
		};
	};
};
```

## board/zhihe/p100-evb/riscv-sec-linux.its
```
/dts-v1/;

/ {
	description = "ZhiHe P100 FIT image";
	#address-cells = <1>;
 
	images {
		kernel-1 {
			description = "Linux Kernel";
			data = /incbin/("../../../../kernel/arch/riscv/boot/Image");
			type = "kernel";
			os = "invalid";
			arch = "riscv";
			compression = "none";
			load = <0x80200000>;
			entry = <0x80200000>;
			hash {
				algo = "sha256";
			};
		};
	
		fdt-1 {
			description = "Device Tree";
			data = /incbin/("../../../../kernel/arch/riscv/boot/dts/zhihe/p100-haps.dtb");
			type = "flat_dt";
			arch = "riscv";
			load = <0x9ff00000>;
			data-size-unciphered = "0xa693";
			cipher {
				algo = "aes256";
				key-name-hint = "aes_key";
				iv = <0x723927f0 0xb547ef19 0x0188af4c 0x85dd4e7d>;
				iv-name-hint = "aes_iv";
			};
			hash {
				algo = "sha256";
			};
		};

		opensbi-1 {
			description = "RISC-V OpenSBI";
			data = /incbin/("../../../../opensbi/build/platform/generic/firmware/fw_dynamic.bin");
			type = "firmware";
			os = "opensbi";
			arch = "riscv";
			compression = "none";
			load = <0x80000000>;
			entry = <0x80000000>;
			hash {
				algo = "sha256";
			};
		};

		u-boot-1 {
			description = "U-Boot";
			data = /incbin/("../../../../u-boot/u-boot.bin");
			type = "firmware";
			os = "u-boot";
			arch = "riscv";
			compression = "none";
			load = <0x90000000>;
			entry = <0x90000000>;
			hash {
				algo = "sha256";
			};
		};
	};
 
	configurations {
		default = "conf-1";
		conf-1 {
			description = "Default Configuration";
			fdt = "fdt-1";
			firmware = "opensbi-1";
			kernel = "kernel-1";
			loadables = "u-boot-1", "kernel-1";
			signature {
				algo = "sha256,rsa2048";
				key-name-hint = "dev";
				sign-images = "kernel", "fdt", "firmware";
			};
		};
	};
};
```

## configs/a200_evb_defconfig
```kconfig
CONFIG_RISCV=y
CONFIG_TEXT_BASE=0x10000000
CONFIG_SYS_MALLOC_LEN=0x4000000
CONFIG_SYS_MALLOC_F_LEN=0xA000
CONFIG_HAS_CUSTOM_SYS_INIT_SP_ADDR=y
CONFIG_CUSTOM_SYS_INIT_SP_ADDR=0x10100000
CONFIG_ENV_SIZE=0x4000
CONFIG_ENV_OFFSET=0x100000
CONFIG_DM_GPIO=y
CONFIG_DEFAULT_DEVICE_TREE="a200-evb"
CONFIG_SPL_TEXT_BASE=0xffe0000800
CONFIG_SPL_MMC=y
CONFIG_SPL_STACK_R_ADDR=0x0FF00000
CONFIG_SPL_STACK=0xffe0180000
CONFIG_SPL_BSS_START_ADDR=0xffe0140000
CONFIG_SPL_BSS_MAX_SIZE=0x2000
CONFIG_SPL_STACK_R=y
CONFIG_SPL=y
CONFIG_ENV_OFFSET_REDUND=0x104000
CONFIG_SYS_LOAD_ADDR=0x0C2000000
CONFIG_BUILD_TARGET="zhihe-rvbl.bin"
# CONFIG_DEBUG_UART is not set
CONFIG_TARGET_A200_EVB=y
CONFIG_SPL_OPENSBI_LOAD_ADDR=0x0
CONFIG_ZHIHE_MMC_OP_SUPPORT=y
CONFIG_ZHIHE_EFUSE_CMD_SUPPORT=y
CONFIG_SPL_FIT_CIPHER=y
CONFIG_SPL_AES=y
CONFIG_LIGHT_AON_CONF=y
CONFIG_PMIC_VOL_INIT=y
CONFIG_DDR_LP4X_3733_DUALRANK=y
CONFIG_FIXUP_MEMORY_REGION=y
CONFIG_ARCH_RV64I=y
CONFIG_RISCV_SMODE=y
# CONFIG_SPL_SMP is not set
CONFIG_STACK_SIZE_SHIFT=16
# CONFIG_OF_BOARD_FIXUP is not set
CONFIG_FIT=y
CONFIG_SPL_FIT_PRINT=y
CONFIG_SPL_FIT_SIGNATURE=y
CONFIG_SPL_LOAD_FIT=y
CONFIG_SPL_LOAD_FIT_ADDRESS=0x19000000
CONFIG_SPL_LOAD_FIT_FULL=y
CONFIG_LEGACY_IMAGE_FORMAT=y
CONFIG_DISTRO_DEFAULTS=y
CONFIG_BOOTDELAY=3
CONFIG_OF_BOARD_SETUP=y
# CONFIG_USE_BOOTCOMMAND is not set
CONFIG_CONSOLE_MUX=y
CONFIG_DISPLAY_CPUINFO=y
CONFIG_DISPLAY_BOARDINFO=y
CONFIG_BOARD_LATE_INIT=y
CONFIG_ZHIHE_RAMBUS_ALGO=y
CONFIG_SPL_MAX_SIZE=0x100000
CONFIG_SPL_PAD_TO=0x0
CONFIG_SPL_BOARD_INIT=y
# CONFIG_SPL_RAW_IMAGE_SUPPORT is not set
CONFIG_SPL_LEGACY_IMAGE_FORMAT=y
# CONFIG_SPL_SHARES_INIT_SP_ADDR is not set
CONFIG_SPL_SYS_MALLOC=y
CONFIG_SPL_HAS_CUSTOM_MALLOC_START=y
CONFIG_SPL_CUSTOM_SYS_MALLOC_ADDR=0x0F000000
CONFIG_SPL_SYS_MALLOC_SIZE=0xC00000
CONFIG_SPL_ENV_SUPPORT=y
CONFIG_SPL_FS_EXT4=y
CONFIG_SPL_FS_LOAD_PAYLOAD_NAME="riscv-linux.itb"
CONFIG_SYS_MMCSD_FS_BOOT_PARTITION=3
CONFIG_SPL_OPENSBI=y
CONFIG_SPL_OPENSBI_SCRATCH_OPTIONS=0x0
CONFIG_SYS_PROMPT="u-boot# "
CONFIG_CMD_CPU=y
CONFIG_CMD_ERASEENV=y
CONFIG_CMD_MD5SUM=y
CONFIG_CMD_MEMINFO=y
CONFIG_CMD_MEMTEST=y
CONFIG_CMD_GPIO=y
CONFIG_CMD_GPT=y
CONFIG_CMD_GPT_RENAME=y
CONFIG_CMD_I2C=y
CONFIG_CMD_MMC=y
CONFIG_CMD_MTD=y
CONFIG_CMD_SPI=y
CONFIG_CMD_USB=y
CONFIG_CMD_WDT=y
CONFIG_CMD_TFTPPUT=y
CONFIG_CMD_TFTPSRV=y
CONFIG_CMD_HASH=y
CONFIG_CMD_EXT4_WRITE=y
# CONFIG_ISO_PARTITION is not set
CONFIG_PARTITION_TYPE_GUID=y
CONFIG_OF_SPL_REMOVE_PROPS=""
CONFIG_ENV_IS_IN_MMC=y
CONFIG_SYS_REDUNDAND_ENVIRONMENT=y
CONFIG_SYS_RELOC_GD_ENV_ADDR=y
CONFIG_ENV_VARS_UBOOT_RUNTIME_CONFIG=y
CONFIG_NET_RANDOM_ETHADDR=y
CONFIG_TFTP_PORT=y
CONFIG_BOOTCOUNT_LIMIT=y
CONFIG_BOOTCOUNT_ENV=y
CONFIG_SPL_CLK=y
CONFIG_USB_FUNCTION_FASTBOOT=y
CONFIG_UDP_FUNCTION_FASTBOOT=y
CONFIG_FASTBOOT_BUF_ADDR=0x11000000
CONFIG_FASTBOOT_BUF_SIZE=0x8000000
CONFIG_FASTBOOT_FLASH=y
CONFIG_FASTBOOT_FLASH_MMC_DEV=0
CONFIG_FASTBOOT_MMC_BOOT_SUPPORT=y
CONFIG_FASTBOOT_MMC_USER_SUPPORT=y
CONFIG_FASTBOOT_CMD_OEM_FORMAT=y
CONFIG_DWAPB_GPIO=y
CONFIG_DM_PCA953X=y
CONFIG_DM_I2C=y
CONFIG_SYS_I2C_DW=y
CONFIG_MISC=y
CONFIG_MMC=y
CONFIG_MMC_BROKEN_CD=y
CONFIG_SUPPORT_EMMC_RPMB=y
CONFIG_SUPPORT_EMMC_BOOT=y
CONFIG_MMC_IO_VOLTAGE=y
CONFIG_MMC_UHS_SUPPORT=y
CONFIG_MMC_HS400_SUPPORT=y
CONFIG_MMC_SDHCI=y
CONFIG_MMC_SDHCI_SDMA=y
CONFIG_MMC_SDHCI_ZHIHE=y
CONFIG_DM_MTD=y
CONFIG_MTD_SPI_NAND=y
CONFIG_SPI_FLASH_WINBOND=y
CONFIG_PHY_MARVELL=y
CONFIG_PHY_REALTEK=y
CONFIG_RTL8211X_PHY_FORCE_MASTER=y
CONFIG_RTL8211F_PHY_FORCE_EEE_RXC_ON=y
CONFIG_ETH_DESIGNWARE=y
CONFIG_DW_ALTDESCRIPTOR=y
CONFIG_MII=y
CONFIG_PHY=y
CONFIG_SYS_NS16550=y
CONFIG_SPI=y
CONFIG_DESIGNWARE_SPI=y
CONFIG_DESIGNWARE_QSPI=y
CONFIG_SYSRESET=y
CONFIG_SYSRESET_WATCHDOG=y
CONFIG_USB=y
CONFIG_USB_XHCI_HCD=y
CONFIG_USB_XHCI_DWC3=y
CONFIG_USB_DWC3=y
CONFIG_USB_GADGET=y
CONFIG_USB_GADGET_MANUFACTURER="ZhiHe"
CONFIG_USB_GADGET_VENDOR_NUM=0x37f2
CONFIG_USB_GADGET_PRODUCT_NUM=0xd00d
# CONFIG_WATCHDOG is not set
# CONFIG_WATCHDOG_AUTOSTART is not set
CONFIG_DESIGNWARE_WATCHDOG=y
# CONFIG_SPL_USE_TINY_PRINTF is not set
# CONFIG_SPL_SHA1 is not set
CONFIG_SPL_GZIP=y
# CONFIG_EFI_LOADER is not set
```

## configs/a210_evb_defconfig
```kconfig
CONFIG_RISCV=y
CONFIG_TEXT_BASE=0x90000000
CONFIG_SYS_MALLOC_LEN=0x4000000
CONFIG_SYS_MALLOC_F_LEN=0x6000
CONFIG_SPL_LDSCRIPT="board/zhihe/a210-evb/arch_ext/u-boot-spl.lds"
CONFIG_HAS_CUSTOM_SYS_INIT_SP_ADDR=y
CONFIG_CUSTOM_SYS_INIT_SP_ADDR=0x90100000
CONFIG_SF_DEFAULT_MODE=0x3
CONFIG_ENV_SIZE=0x4000
CONFIG_ENV_OFFSET=0x100000
CONFIG_DM_GPIO=y
CONFIG_DEFAULT_DEVICE_TREE="a210-evb"
CONFIG_SPL_TEXT_BASE=0x70000800
CONFIG_SPL_MMC=y
CONFIG_SPL_STACK_R_ADDR=0x8FF00000
CONFIG_SPL_STACK=0x70200000
CONFIG_SPL_BSS_START_ADDR=0x70180000
CONFIG_SPL_BSS_MAX_SIZE=0x2000
CONFIG_SPL_STACK_R=y
CONFIG_SPL=y
CONFIG_ENV_OFFSET_REDUND=0x104000
CONFIG_SYS_LOAD_ADDR=0x8C200000
CONFIG_BUILD_TARGET="zhihe-rvbl.bin"
# CONFIG_DEBUG_UART is not set
CONFIG_TARGET_A210_EVB=y
CONFIG_SPL_OPENSBI_LOAD_ADDR=0x80000000
CONFIG_ZHIHE_MMC_OP_SUPPORT=y
CONFIG_ZHIHE_EFUSE_CMD_SUPPORT=y
CONFIG_ZHP100EVB_LP4X_4266_1R_2D=y
CONFIG_ZHP100EVB_LP4X_4266_2R_2D=y
CONFIG_SPL_FIT_CIPHER=y
CONFIG_SPL_AES=y
CONFIG_ARCH_RV64I=y
CONFIG_RISCV_SMODE=y
# CONFIG_SPL_SMP is not set
CONFIG_STACK_SIZE_SHIFT=16
# CONFIG_OF_BOARD_FIXUP is not set
CONFIG_FIT=y
CONFIG_SPL_FIT_PRINT=y
CONFIG_SPL_FIT_SIGNATURE=y
CONFIG_SPL_LOAD_FIT=y
CONFIG_SPL_LOAD_FIT_ADDRESS=0x99000000
CONFIG_SPL_LOAD_FIT_FULL=y
CONFIG_LEGACY_IMAGE_FORMAT=y
CONFIG_DISTRO_DEFAULTS=y
CONFIG_NAND_BOOT=y
CONFIG_QSPI_BOOT=y
CONFIG_SD_BOOT=y
CONFIG_SPI_BOOT=y
CONFIG_BOOTDELAY=3
CONFIG_OF_BOARD_SETUP=y
# CONFIG_USE_BOOTCOMMAND is not set
CONFIG_CONSOLE_MUX=y
CONFIG_DISPLAY_CPUINFO=y
CONFIG_DISPLAY_BOARDINFO=y
CONFIG_BOARD_EARLY_INIT_F=y
CONFIG_BOARD_LATE_INIT=y
CONFIG_ZHIHE_RAMBUS_ALGO=y
CONFIG_SPL_MAX_SIZE=0xEF800
CONFIG_SPL_PAD_TO=0x0
CONFIG_SPL_BOARD_INIT=y
# CONFIG_SPL_RAW_IMAGE_SUPPORT is not set
CONFIG_SPL_LEGACY_IMAGE_FORMAT=y
# CONFIG_SPL_SHARES_INIT_SP_ADDR is not set
CONFIG_SPL_SYS_MALLOC=y
CONFIG_SPL_HAS_CUSTOM_MALLOC_START=y
CONFIG_SPL_CUSTOM_SYS_MALLOC_ADDR=0x8F000000
CONFIG_SPL_SYS_MALLOC_SIZE=0xC00000
CONFIG_SYS_MMCSD_RAW_MODE_U_BOOT_USE_SECTOR=y
CONFIG_SYS_MMCSD_RAW_MODE_U_BOOT_SECTOR=0x680
CONFIG_SPL_ENV_SUPPORT=y
CONFIG_SPL_FS_EXT4=y
CONFIG_SYS_MMCSD_FS_BOOT_PARTITION=3
CONFIG_SPL_OPENSBI=y
CONFIG_SPL_OPENSBI_SCRATCH_OPTIONS=0x0
CONFIG_SYS_PROMPT="u-boot# "
CONFIG_CMD_CPU=y
CONFIG_CMD_ERASEENV=y
CONFIG_CMD_MD5SUM=y
CONFIG_CMD_MEMINFO=y
CONFIG_CMD_MEMTEST=y
CONFIG_CMD_GPIO=y
CONFIG_CMD_GPT=y
CONFIG_CMD_GPT_RENAME=y
CONFIG_CMD_I2C=y
CONFIG_CMD_MMC=y
CONFIG_CMD_MMC_REG=y
CONFIG_CMD_MTD=y
CONFIG_CMD_SF_TEST=y
CONFIG_CMD_SPI=y
CONFIG_CMD_WDT=y
CONFIG_CMD_TFTPPUT=y
CONFIG_CMD_TFTPSRV=y
CONFIG_CMD_HASH=y
CONFIG_CMD_EXT4_WRITE=y
CONFIG_MMC_SPEED_MODE_SET=y
# CONFIG_ISO_PARTITION is not set
CONFIG_PARTITION_TYPE_GUID=y
CONFIG_OF_SPL_REMOVE_PROPS=""
CONFIG_ENV_IS_IN_MMC=y
CONFIG_SYS_REDUNDAND_ENVIRONMENT=y
CONFIG_SYS_RELOC_GD_ENV_ADDR=y
CONFIG_ENV_VARS_UBOOT_RUNTIME_CONFIG=y
CONFIG_NET_RANDOM_ETHADDR=y
CONFIG_IP_DEFRAG=y
CONFIG_TFTP_BLOCKSIZE=16352
CONFIG_TFTP_PORT=y
CONFIG_BOOTCOUNT_LIMIT=y
CONFIG_BOOTCOUNT_ENV=y
CONFIG_SPL_CLK=y
CONFIG_SPL_CLK_CCF=y
CONFIG_CLK_CCF=y
CONFIG_CLK_ZHIHE_A210=y
CONFIG_USB_FUNCTION_FASTBOOT=y
CONFIG_UDP_FUNCTION_FASTBOOT=y
CONFIG_FASTBOOT_BUF_ADDR=0x91000000
CONFIG_FASTBOOT_BUF_SIZE=0x8000000
CONFIG_FASTBOOT_FLASH=y
CONFIG_FASTBOOT_FLASH_MMC_DEV=0
CONFIG_FASTBOOT_MMC_BOOT_SUPPORT=y
CONFIG_FASTBOOT_MMC_USER_SUPPORT=y
CONFIG_FASTBOOT_CMD_OEM_FORMAT=y
CONFIG_DWAPB_GPIO=y
CONFIG_DM_I2C=y
CONFIG_I2C_SET_DEFAULT_BUS_NUM=y
CONFIG_SYS_I2C_DW=y
CONFIG_MMC=y
CONFIG_MMC_BROKEN_CD=y
CONFIG_SUPPORT_EMMC_RPMB=y
CONFIG_SUPPORT_EMMC_BOOT=y
CONFIG_MMC_IO_VOLTAGE=y
CONFIG_MMC_UHS_SUPPORT=y
CONFIG_MMC_HS400_SUPPORT=y
CONFIG_MMC_SDHCI=y
CONFIG_MMC_SDHCI_SDMA=y
# CONFIG_SPL_MMC_SDHCI_SDMA is not set
CONFIG_MMC_SDHCI_ZHIHE=y
CONFIG_DM_MTD=y
# CONFIG_MTD_RAW_NAND is not set
CONFIG_MTD_SPI_NAND=y
# CONFIG_SPI_FLASH_SMART_HWCAPS is not set
CONFIG_SPI_FLASH_GIGADEVICE=y
CONFIG_SPI_FLASH_ISSI=y
CONFIG_SPI_FLASH_MACRONIX=y
CONFIG_SPI_FLASH_STMICRO=y
CONFIG_SPI_FLASH_WINBOND=y
CONFIG_SPI_FLASH_MTD=y
CONFIG_PHY_MARVELL=y
CONFIG_PHY_REALTEK=y
CONFIG_RTL8211X_PHY_FORCE_MASTER=y
CONFIG_RTL8211F_PHY_FORCE_EEE_RXC_ON=y
CONFIG_PHY_GIGE=y
CONFIG_DWC_ETH_QOS=y
CONFIG_DWC_ETH_QOS_ZHIHE=y
CONFIG_RGMII=y
CONFIG_MII=y
CONFIG_PHY=y
CONFIG_SYS_NS16550=y
CONFIG_SYS_NS16550_MEM32=y
CONFIG_SPI=y
CONFIG_DESIGNWARE_QSPI=y
CONFIG_SYSRESET=y
CONFIG_SYSRESET_WATCHDOG=y
CONFIG_USB=y
CONFIG_USB_GADGET=y
CONFIG_USB_GADGET_VENDOR_NUM=0x37f2
CONFIG_USB_GADGET_PRODUCT_NUM=0xd00d
CONFIG_USB_GADGET_DWC2_OTG=y
CONFIG_USB_GADGET_DWC2_OTG_PHY_BUS_WIDTH_8=y
# CONFIG_WATCHDOG is not set
# CONFIG_WATCHDOG_AUTOSTART is not set
CONFIG_DESIGNWARE_WATCHDOG=y
# CONFIG_SPL_USE_TINY_PRINTF is not set
# CONFIG_SPL_SHA1 is not set
CONFIG_SPL_GZIP=y
# CONFIG_EFI_LOADER is not set
```
