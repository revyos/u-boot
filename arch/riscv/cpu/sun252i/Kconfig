## arch/riscv/cpu/sun252i/Kconfig
```kconfig
# SPDX-License-Identifier: GPL-2.0+

if TARGET_SUN252I

config MACH_SUN252I_V861
	bool
	default y
	select ARCH_SUNXI
	select ARCH_EARLY_INIT_R
	select BINMAN
	select SUPPORT_SPL
	select SYS_CACHE_SHIFT_6
	select SUNXI_GPIO
	select SUNXI_NEW_PINCTRL
	imply SPL_GPIO
	imply CPU
	imply CPU_RISCV
	imply CMD_CPU
	imply SPL_CPU
	imply SPL_OPENSBI
	select DRAM_SUN20I_D1

config DRAM_CLK
	int
	default 1056

config SYS_CLK_FREQ
	default 1008000000

config DRAM_ZQ
	int
	default 8088571

config SYS_BOARD
	default "sunxi"

config SYS_CPU
	default "sun252i"

config SYS_CONFIG_NAME
	default "sun252i"

config TEXT_BASE
	default 0x42000000

config SPL_IMAGE_TYPE
	default "sunxi_egon"

config BOARD_SPECIFIC_OPTIONS
	def_bool y
	select OF_HAS_PRIOR_STAGE

endif
```

## arch/riscv/cpu/zhxtc9/Kconfig
```kconfig
# SPDX-License-Identifier: GPL-2.0+
#
# Copyright(C) 2024-2025 Zhihe Computing Technology (Shenzhen) Co., Ltd.

config CPU_ZHXTC9
	bool
	select ARCH_EARLY_INIT_R
	select SYS_CACHE_SHIFT_6
	select CPU
	select CPU_RISCV
	select RISCV_TIMER
```

## board/zhihe/a200-evb/riscv-boot.its
```
/dts-v1/;

/ {
	description = "ZhiHe A200 Boot FIT image";
	#address-cells = <1>;
 
	images {
		fdt-licheepi {
			description = "LicheePi Device Tree";
			data = /incbin/("replace-path/th1520-lichee-pi-4a.dtb");
			type = "flat_dt";
			arch = "riscv";
			compression = "none";
			load = <0x0c000000>;
			hash {
				algo = "sha256";
			};
		};

		fdt-evb {
			description = "DEV Device Tree";
			data = /incbin/("replace-path/a200-evb.dtb");
			type = "flat_dt";
			arch = "riscv";
			compression = "none";
			load = <0x0c000000>;
			hash {
				algo = "sha256";
			};
		};

		opensbi-1 {
			description = "RISC-V OpenSBI";
			data = /incbin/("replace-path/fw_dynamic.bin.gz");
			type = "firmware";
			os = "opensbi";
			arch = "riscv";
			compression = "gzip";
			load = <0x00000000>;
			entry = <0x00000000>;
			hash {
				algo = "sha256";
			};
		};

		u-boot-1 {
			description = "U-Boot";
			data = /incbin/("replace-path/u-boot.bin.gz");
			type = "firmware";
			os = "u-boot";
			arch = "riscv";
			compression = "gzip";
			load = <0x10000000>;
			entry = <0x10000000>;
			hash {
				algo = "sha256";
			};
		};

		aon-1 {
			description = "AON";
			data = /incbin/("replace-path/light_aon_fpga.bin");
			type = "firmware";
			arch = "riscv";
			compression = "none";
			load = <0xff 0xffef8000>;
			entry = <0xff 0xffef8000>;
			hash {
				algo = "sha256";
			};
		};
	};

	configurations {
		default = "th1520-lichee-pi-4a";
		th1520-lichee-pi-4a {
			description = "Default Configuration";
			fdt = "fdt-licheepi";
			firmware = "opensbi-1";
			loadables = "u-boot-1", "aon-1";
			invalid_signature {
				algo = "sha256,rsa2048";
				key-name-hint = "signature_key_name";
				sign-images = "fdt", "firmware";
			};
		};

		a200-evb {
			description = "Default Configuration";
			fdt = "fdt-evb";
			firmware = "opensbi-1";
			loadables = "u-boot-1", "aon-1";
			invalid_signature {
				algo = "sha256,rsa2048";
				key-name-hint = "signature_key_name";
				sign-images = "fdt", "firmware";
			};
		};
	};
};
```

## board/zhihe/a200-evb/riscv-linux.its
```
/dts-v1/;

/ {
	description = "ZhiHe A200 Linux FIT image";
	#address-cells = <1>;
 
	images {
		kernel-1 {
			description = "Linux Kernel";
			data = /incbin/("replace-path/Image");
			type = "kernel";
			os = "linux";
			arch = "riscv";
			compression = "none";
			load = <0x00200000>;
			entry = <0x00200000>;
			invalid_hash {
				algo = "sha256";
			};
		};
	
		fdt-1 {
			description = "Device Tree";
			data = /incbin/("replace-path/replace-dtb");
			type = "flat_dt";
			arch = "riscv";
			compression = "none";
			load = <0x1ff00000>;
			invalid_hash {
				algo = "sha256";
			};
		};

		opensbi-1 {
			description = "RISC-V OpenSBI";
			data = /incbin/("replace-path/fw_dynamic.bin");
			type = "firmware";
			os = "opensbi";
			arch = "riscv";
			compression = "none";
			load = <0x00000000>;
			entry = <0x00000000>;
			invalid_hash {
				algo = "sha256";
			};
		};

		u-boot-1 {
			description = "U-Boot";
			data = /incbin/("replace-path/u-boot.bin");
			type = "firmware";
			os = "u-boot";
			arch = "riscv";
			compression = "none";
			load = <0x10000000>;
			entry = <0x10000000>;
			invalid_hash {
				algo = "sha256";
			};
		};

		aon-1 {
			description = "AON";
			data = /incbin/("replace-path/light_aon_fpga.bin");
			type = "firmware";
			arch = "riscv";
			compression = "none";
			load = <0xff 0xffef8000>;
			entry = <0xff 0xffef8000>;
			invalid_hash {
				algo = "sha256";
			};
		};

		initrd-1 {
			description = "INITRD";
			data = /incbin/("replace-path/initrd");
			type = "firmware";
			arch = "riscv";
			compression = "none";
			load = <0x1e000000>;
			entry = <0x1e000000>;
			invalid_hash {
				algo = "sha256";
			};
		};

		audio-1 {
			description = "Audio";
			data = /incbin/("replace-path/light_c906_audio.bin");
			type = "firmware";
			arch = "riscv";
			compression = "none";
			load = <0x32000000>;
			entry = <0x32000000>;
			invalid_hash {
				algo = "sha256";
			};
		};

		str-1 {
			description = "STR";
			data = /incbin/("replace-path/str.bin");
			type = "firmware";
			arch = "riscv";
			compression = "none";
			load = <0xff 0xe0000000>;
			entry = <0xff 0xe0000000>;
			invalid_hash {
				algo = "sha256";
			};
		};
	};

	configurations {
		default = "conf-1";
		conf-1 {
			description = "Default Configuration";
			fdt = "fdt-1";
			firmware = "opensbi-1";
			kernel = "kernel-1";
			uboot = "u-boot-1";
			aon = "aon-1";
			initrd = "initrd-1";
			audio = "audio-1";
			str = "str-1";
			loadables = "u-boot-1", "kernel-1", "aon-1", "initrd-1", "audio-1", "str-1";
			invalid_signature {
				algo = "sha256,rsa2048";
				key-name-hint = "signature_key_name";
				sign-images = "kernel", "fdt", "firmware", "uboot", "aon", "initrd", "audio-1", "str-1";
			};
		};
	};
};
```

## board/zhihe/a210-evb/Kconfig
```kconfig
if TARGET_A210_EVB

source board/zhihe/common/Kconfig

config SYS_BOARD
	default "a210-evb"

choice
	prompt "Configure the A210 sub platform"
	optional

config A210_EVB_ON_HAPS
	bool "HAPS"

config A210_EVB_ON_EMU
	bool "EMU"

endchoice

config SYS_VENDOR
	default "zhihe"

config SYS_CPU
	default "zhxtc9"

config SYS_CONFIG_NAME
	default "a210-evb"

config ZHP100EVB_DDR_INIT
	bool "Configure the A210 evb DDR init"
	default y

config SOC_ZHIHE_D2D
	bool "Configure d2d"


config ZHP100EVB_AUXDISP_CMD_SUPPORT
        bool "Support configure auxdisp for zhihe a210-evb in uboot command line"
        default n
config ZHP100EVB_GPU_MAX_POWER_TEST
        bool "Support run gpu max power test"
        default n

config ZHP100EVB_USBATE_CMD_SUPPORT
        bool "USB C10PHY ATE unit test for zhihe a210-evb in uboot command line"
        default n

config ZHP100EVB_PCIEATE_CMD_SUPPORT
        bool "PCIe ATE unit test for zhihe a210-evb in uboot command line"
        default n

config ZHP100EMU_LP4X
	bool "ZHP100EMU_LP4X"

config ZHP100EVB_DDR_DUMMY
	bool "ZHP100EVB_DDR_DUMMY"

config ZHP100EVB_LP4X_4266_1R_2D
	bool "ZHP100EVB_LP4X_4266_1R_2D"

config ZHP100EVB_LP4X_3733_1R_2D
	bool "ZHP100EVB_LP4X_3733_1R_2D"

config ZHP100EVB_LP4X_3200_1R_2D
	bool "ZHP100EVB_LP4X_3200_1R_2D"

config ZHP100EVB_LP4X_4266_2R_2D
	bool "ZHP100EVB_LP4X_4266_2R_2D"

config LPDDR_EYE
        bool "DDR diagnose mode configuration"
        def_bool n

config FW_MSG_L3
        bool "DDR firmware message L3"
	def_bool n
config FW_MSG_L2
        bool "DDR firmware message L2"
	def_bool n
config FW_MSG_L1
        bool "DDR firmware message L1"
	def_bool n
config FW_MSG_TRAIN_1D
        bool "DDR firmware message train 1D"
	def_bool n
config DDR_MSG
	def_bool y if FW_MSG_L1 || FW_MSG_L2 || FW_MSG_L3

config SPL_FIT_CIPHER
	bool "SPL_FIT_CIPHER"
	depends on SPL
	select FIT_CIPHER

config SPL_AES
	bool "SPL_AES"
	depends on SPL

config BOARD_SPECIFIC_OPTIONS
	def_bool y
	select CPU_ZHXTC9
	imply SUPPORT_OF_CONTROL
	imply OF_CONTROL
	imply OF_REAL
	imply SUPPORT_SPL
	imply SPL_CPU
endif
```

## board/zhihe/a210-evb/riscv-boot-sec.its
```
/dts-v1/;

/ {
	description = "ZhiHe A210 Boot FIT image";
	#address-cells = <1>;

	images {
		tee-1 {
			description = "optee-os";
			data = /incbin/("replace-path/tee.bin.gz");
			type = "firmware";
			os = "tee";
			arch = "riscv";
			compression = "gzip";
			load = <0x88000000>;
			entry = <0x88000000>;
			invalid_hash {
					algo = "sha256";
			};
		};
		fdt-evb {
			description = "EVB Device Tree";
			data = /incbin/("replace-path/a210-evb-sec.dtb");
			type = "flat_dt";
			arch = "riscv";
			compression = "none";
			load = <0x8c000000>;
			invalid_hash {
				algo = "sha256";
			};
		};

		fdt-dev {
			description = "DEV Device Tree";
			data = /incbin/("replace-path/a210-dev-sec.dtb");
			type = "flat_dt";
			arch = "riscv";
			compression = "none";
			load = <0x8c000000>;
			invalid_hash {
				algo = "sha256";
			};
		};

		opensbi-1 {
			description = "RISC-V OpenSBI";
			data = /incbin/("replace-path/fw_dynamic.bin.gz");
			type = "firmware";
			os = "opensbi";
			arch = "riscv";
			compression = "gzip";
			load = <0x80000000>;
			entry = <0x80000000>;
			invalid_hash {
				algo = "sha256";
			};
		};

		u-boot-1 {
			description = "U-Boot";
			data = /incbin/("replace-path/u-boot.bin.gz");
			type = "firmware";
			os = "u-boot";
			arch = "riscv";
			compression = "gzip";
			load = <0x90000000>;
			entry = <0x90000000>;
			invalid_hash {
				algo = "sha256";
			};
		};

		aon-1 {
			description = "AON";
			data = /incbin/("replace-path/a210-aon.bin");
			type = "firmware";
			arch = "riscv";
			compression = "none";
			load = <0x308f8000>;
			entry = <0x308f8000>;
			invalid_hash {
				algo = "sha256";
			};
		};
	};

	configurations {
		default = "a210-evb-sec";
		a210-evb-sec {
			description = "EVB Configuration";
			fdt = "fdt-evb";
			firmware = "opensbi-1";
			tee = "tee-1";
			loadables = "u-boot-1", "aon-1", "tee-1";
			invalid_signature {
				algo = "sha256,rsa2048";
				key-name-hint = "signature_key_name";
				sign-images = "fdt", "firmware", "uboot", "aon", "tee";
			};
		};

		a210-dev-sec {
			description = "DEV Configuration";
			fdt = "fdt-dev";
			firmware = "opensbi-1";
			tee = "tee-1";
			loadables = "u-boot-1", "aon-1", "tee-1";
			invalid_signature {
				algo = "sha256,rsa2048";
				key-name-hint = "signature_key_name";
				sign-images = "fdt", "firmware", "uboot", "aon", "tee";
			};
		};
	};
};
```

## board/zhihe/a210-evb/riscv-boot.its
```
/dts-v1/;

/ {
	description = "ZhiHe A210 Boot FIT image";
	#address-cells = <1>;

	images {
		fdt-evb {
			description = "EVB Device Tree";
			data = /incbin/("replace-path/a210-evb.dtb");
			type = "flat_dt";
			arch = "riscv";
			compression = "none";
			load = <0x8c000000>;
			hash {
				algo = "sha256";
			};
		};

		fdt-dev {
			description = "DEV Device Tree";
			data = /incbin/("replace-path/a210-dev.dtb");
			type = "flat_dt";
			arch = "riscv";
			compression = "none";
			load = <0x8c000000>;
			hash {
				algo = "sha256";
			};
		};

		fdt-evb-d2d {
			description = "EVB D2D Device Tree";
			data = /incbin/("replace-path/a210-evb-d2d.dtb");
			type = "flat_dt";
			arch = "riscv";
			compression = "none";
			load = <0x8c000000>;
			hash {
				algo = "sha256";
			};
		};

		opensbi-1 {
			description = "RISC-V OpenSBI";
			data = /incbin/("replace-path/fw_dynamic.bin.gz");
			type = "firmware";
			os = "opensbi";
			arch = "riscv";
			compression = "gzip";
			load = <0x80000000>;
			entry = <0x80000000>;
			hash {
				algo = "sha256";
			};
		};

		u-boot-1 {
			description = "U-Boot";
			data = /incbin/("replace-path/u-boot.bin.gz");
			type = "firmware";
			os = "u-boot";
			arch = "riscv";
			compression = "gzip";
			load = <0x90000000>;
			entry = <0x90000000>;
			hash {
				algo = "sha256";
			};
		};
	};

	configurations {
		default = "a210-evb";
		a210-evb {
			description = "EVB Configuration";
			fdt = "fdt-evb";
			firmware = "opensbi-1";
			loadables = "u-boot-1";
			invalid_signature {
				algo = "sha256,rsa2048";
				key-name-hint = "signature_key_name";
				sign-images = "fdt", "firmware", "uboot";
			};
		};

		a210-dev {
			description = "DEV Configuration";
			fdt = "fdt-dev";
			firmware = "opensbi-1";
			loadables = "u-boot-1";
			invalid_signature {
				algo = "sha256,rsa2048";
				key-name-hint = "signature_key_name";
				sign-images = "fdt", "firmware", "uboot";
			};
		};

		a210-evb-d2d {
			description = "EVB D2D Configuration";
			fdt = "fdt-evb-d2d";
			firmware = "opensbi-1";
			loadables = "u-boot-1";
			invalid_signature {
				algo = "sha256,rsa2048";
				key-name-hint = "signature_key_name";
				sign-images = "fdt", "firmware", "uboot";
			};
		};
	};
};
```

## board/zhihe/a210-evb/riscv-linux.its
```
/dts-v1/;

/ {
	description = "ZhiHe A210 FIT image";
	#address-cells = <1>;
 
	images {
		kernel-1 {
			description = "Linux Kernel";
			data = /incbin/("replace-path/Image");
			type = "kernel";
			os = "linux";
			arch = "riscv";
			compression = "none";
			load = <0x80200000>;
			entry = <0x80200000>;
			invalid_hash {
				algo = "sha256";
			};
		};
	
		fdt-1 {
			description = "Default Device Tree";
			data = /incbin/("replace-path/replace-dtb");
			type = "flat_dt";
			arch = "riscv";
			compression = "none";
			load = <0x8c000000>;
			invalid_hash {
				algo = "sha256";
			};
		};

		fdt-2 {
			description = "Core Device Tree";
			data = /incbin/("replace-path/replace2-dtb");
			type = "flat_dt";
			arch = "riscv";
			compression = "none";
			load = <0x8c000000>;
			invalid_hash {
				algo = "sha256";
			};
		};

		opensbi-1 {
			description = "RISC-V OpenSBI";
			data = /incbin/("replace-path/fw_dynamic.bin");
			type = "firmware";
			os = "opensbi";
			arch = "riscv";
			compression = "none";
			load = <0x80000000>;
			entry = <0x80000000>;
			invalid_hash {
				algo = "sha256";
			};
		};

		u-boot-1 {
			description = "U-Boot";
			data = /incbin/("replace-path/u-boot.bin");
			type = "firmware";
			os = "u-boot";
			arch = "riscv";
			compression = "none";
			load = <0x90000000>;
			entry = <0x90000000>;
			invalid_hash {
				algo = "sha256";
			};
		};

		aon-1 {
			description = "AON";
			data = /incbin/("replace-path/a210-aon.bin");
			type = "firmware";
			arch = "riscv";
			compression = "none";
			load = <0x308f8000>;
			entry = <0x308f8000>;
			invalid_hash {
				algo = "sha256";
			};
		};

		initrd-1 {
			description = "INITRD";
			data = /incbin/("replace-path/initrd");
			type = "firmware";
			arch = "riscv";
			compression = "none";
			load = <0x9e000000>;
			entry = <0x9e000000>;
			invalid_hash {
				algo = "sha256";
			};
		};
	};

	configurations {
		default = "conf-evb";
		conf-evb {
			description = "EVB Configuration";
			fdt = "fdt-1";
			firmware = "opensbi-1";
			kernel = "kernel-1";
			uboot = "u-boot-1";
			aon = "aon-1";
			initrd = "initrd-1";
			loadables = "u-boot-1", "kernel-1", "aon-1", "initrd-1";
			invalid_signature {
				algo = "sha256,rsa2048";
				key-name-hint = "signature_key_name";
				sign-images = "kernel", "fdt", "firmware", "uboot", "aon", "initrd";
			};
		};

		conf-dev {
			description = "DEV Configuration";
			fdt = "fdt-2";
			firmware = "opensbi-1";
			kernel = "kernel-1";
			uboot = "u-boot-1";
			aon = "aon-1";
			initrd = "initrd-1";
			loadables = "u-boot-1", "kernel-1", "aon-1", "initrd-1";
			invalid_signature {
				algo = "sha256,rsa2048";
				key-name-hint = "signature_key_name";
				sign-images = "kernel", "fdt", "firmware", "uboot", "aon", "initrd";
			};
		};
	};
};
```

## board/zhihe/common/Kconfig
```kconfig
config ZHIHE_MMC_OP_SUPPORT
	depends on MMC
	bool "Configure Zhihe MMC operation support"
	default n
	help
		Configure the Zhihe MMC operation support.

config ZHIHE_EFUSE_CMD_SUPPORT
	bool "Configure Zhihe efuse cmd line support"
	default n
	help
		Configure Zhihe efuse cmd line support
```
